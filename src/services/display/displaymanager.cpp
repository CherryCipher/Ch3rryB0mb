#include "displaymanager.h"

/**
 * @brief Constructs a new DisplayManager.
 *
 * Stores the Logger reference for use during display initialization
 * and runtime operations.
 */
DisplayManager::DisplayManager(Logger& logger)
    : logger(logger)
{
}

/**
 * @brief Initializes the display hardware and LVGL.
 *
 * Initializes the physical TFT display, starts LVGL and registers
 * the display flush callback used to transfer rendered pixels to
 * the physical screen.
 *
 * Workflow
 * --------
 * @code
 * Start DisplayManager
 *        │
 *        ▼
 * Initialize TFT hardware
 *        │
 *        ▼
 * Set display rotation
 *        │
 *        ▼
 * Initialize LVGL
 *        │
 *        ▼
 * Create LVGL display
 *        │
 *        ▼
 * Configure LVGL render buffer
 *        │
 *        ▼
 * Register display flush callback
 *        │
 *        ▼
 * Display ready for LVGL
 * @endcode
 *
 * @return true if the display initialized successfully.
 * @return false otherwise.
 */
bool DisplayManager::start()
{
    if (running)
    {
        logger.info("DisplayManager already running.");
        return true;
    }

    logger.info("Starting DisplayManager.");

    // Enable display backlight
    pinMode(TFT_BL, OUTPUT);
    digitalWrite(TFT_BL, TFT_BACKLIGHT_ON);

    // Initialize physical TFT display
    tft.init();
    tft.setRotation(3); //Usb plug to the left, screen facing you, top of screen is up
    tft.fillScreen(TFT_BLACK);

    //If you experience color inversion on your CYD, uncomment the following line to disable it.
    //In my particualr case, the colors were inverted on my CYD, so I had to uncomment this line.
    tft.invertDisplay(false);


    // Initialize LVGL
    lv_init();

    // Create LVGL display
    lvDisplay = lv_display_create(
        tft.width(),
        tft.height()
    );

    if (lvDisplay == nullptr)
    {
        logger.error("Failed to create LVGL display.");
        return false;
    }

    // Store this DisplayManager instance inside the LVGL display.
    // The static flush callback can retrieve it when drawing.
    lv_display_set_user_data(lvDisplay, this);

    // Allocate a partial LVGL render buffer.
    const uint32_t bufferSize =
        tft.width() * 20 * sizeof(lv_color_t);

    buffer = malloc(bufferSize);

    if (buffer == nullptr)
    {
        logger.error("Failed to allocate LVGL display buffer.");
        return false;
    }

    lv_display_set_buffers(
        lvDisplay,
        buffer,
        nullptr,
        bufferSize,
        LV_DISPLAY_RENDER_MODE_PARTIAL
    );

    // Register callback used by LVGL to write pixels to the TFT.
    lv_display_set_flush_cb(lvDisplay, flushDisplay);

    running = true;

    logger.info("DisplayManager started.");

    return true;
}

/**
 * @brief Transfers rendered LVGL pixels to the physical display.
 *
 * LVGL calls this function whenever part of the screen needs to be
 * updated. The generated pixel data is transferred to the TFT using
 * TFT_eSPI.
 *
 * Workflow
 * --------
 * @code
 * LVGL renders screen area
 *        │
 *        ▼
 * flushDisplay()
 *        │
 *        ▼
 * Retrieve DisplayManager
 *        │
 *        ▼
 * Calculate render area
 *        │
 *        ▼
 * Open TFT SPI transaction
 *        │
 *        ▼
 * Transfer pixels to TFT
 *        │
 *        ▼
 * Close TFT SPI transaction
 *        │
 *        ▼
 * Notify LVGL flush completed
 * @endcode
 *
 * @param display LVGL display requesting the transfer.
 * @param area Area of the display that needs to be updated.
 * @param pxMap Pixel data generated by LVGL.
 */
void DisplayManager::flushDisplay(
    lv_display_t* display,
    const lv_area_t* area,
    uint8_t* pxMap
)
{
    DisplayManager* manager =
        static_cast<DisplayManager*>(
            lv_display_get_user_data(display)
        );

    if (manager == nullptr)
    {
        lv_display_flush_ready(display);
        return;
    }

    const uint32_t width =
        area->x2 - area->x1 + 1;

    const uint32_t height =
        area->y2 - area->y1 + 1;

    manager->tft.startWrite();

    manager->tft.setAddrWindow(
        area->x1,
        area->y1,
        width,
        height
    );

    manager->tft.pushColors(
        reinterpret_cast<uint16_t*>(pxMap),
        width * height,
        true
    );

    manager->tft.endWrite();

    // Tell LVGL the transfer has completed.
    lv_display_flush_ready(display);
}

/**
 * @brief Processes LVGL display updates.
 *
 * Calls the LVGL timer handler while the DisplayManager is running.
 *
 * Workflow
 * --------
 * @code
 * update()
 *    │
 *    ▼
 * Display running?
 *    │
 *    ├── No ──► Return
 *    │
 *    ▼
 * Process LVGL timers
 *    │
 *    ▼
 * Render pending UI updates
 * @endcode
 */
void DisplayManager::update()
{
    if (!running)
    {
        return;
    }

    lv_timer_handler();
}

/**
 * @brief Returns whether the display is initialized.
 *
 * @return true if the display is initialized.
 * @return false otherwise.
 */
bool DisplayManager::isRunning() const
{
    return running;
}